## boardspecific/meta-container-intel/conf/layer.conf
```bitbake
# We have a conf and classes directory, add to BBPATH
BBPATH =. "${LAYERDIR}:"

# We have recipes-* directories, add to BBFILES
BBFILES += "${LAYERDIR}/recipes-*/*/*.bb \
            ${LAYERDIR}/recipes-*/*/*.bbappend"

BBFILE_COLLECTIONS += "container-intel"
BBFILE_PATTERN_container-intel = "^${LAYERDIR}/"
BBFILE_PRIORITY_container-intel = "81"
LAYERSERIES_COMPAT_container-intel = "thrd"
```

## boardspecific/meta-container-renesas/conf/layer.conf
```bitbake
# We have a conf and classes directory, add to BBPATH
BBPATH =. "${LAYERDIR}:"

# We have recipes-* directories, add to BBFILES
BBFILES += "${LAYERDIR}/recipes-*/*/*.bb \
            ${LAYERDIR}/recipes-*/*/*.bbappend"

BBFILE_COLLECTIONS += "container-renesas"
BBFILE_PATTERN_container-renesas = "^${LAYERDIR}/"
BBFILE_PRIORITY_container-renesas = "81"
LAYERSERIES_COMPAT_container-renesas = "thud"
```

## conf/layer.conf
```bitbake
# We have a conf and classes directory, add to BBPATH
BBPATH =. "${LAYERDIR}:"

# We have recipes-* directories, add to BBFILES
BBFILES += "${LAYERDIR}/recipes-*/*/*.bb \
            ${LAYERDIR}/recipes-*/*/*.bbappend"

BBFILE_COLLECTIONS += "container-host"
BBFILE_PATTERN_container-host = "^${LAYERDIR}/"
BBFILE_PRIORITY_container-host = "80"
LAYERSERIES_COMPAT_container-host = "thrd"
```
